## drivers/debug_utils/Kconfig
```kconfig
# SPDX-License-Identifier: GPL-2.0
#
#  debug utils configuration
#

menuconfig DEBUG_UTILS
	bool "debug utils support"
	default y
	---help---
	  This option adds extra debug utils.

if DEBUG_UTILS
config DEBUG_UTILS_QUEUE_BUFFER
	bool "queue buffer support"
	default y
	---help---
	  provide print_queue and flush_queue interfaces.
endif
```

## drivers/test/Kconfig
```kconfig
# SPDX-License-Identifier: GPL-2.0-only
#
# Test modules
#

menuconfig TEST
	tristate "Test support"
	help
	  This enables test module.

if TEST

config TIMER
	tristate "Timer test module"
	depends on NO_HZ_IDLE || NO_HZ_FULL
	help
	  Must configure idle-states with local-timer-stop;
          Must configure timer with no always-on.
endif
```
